Datasheet
=========

* `ESP32-S3-WROOM-1-N16R8`_ (Datasheet)
* `OLED Display Module`_ (Datasheet)
* `SA868`_ (Datasheet)
* `Slide and Rotary Encoder Switches`_ (Datasheet)

.. _ESP32-S3-WROOM-1-N16R8: https://www.espressif.com.cn/sites/default/files/documentation/esp32-s3-wroom-1_wroom-1u_datasheet_en.pdf
.. _OLED Display Module: https://github.com/Xinyuan-LilyGO/T-TWR/blob/master/datasheet/SPEC%20X096-2864KSWPG17-C30%20VER%20A.pdf
.. _SA868: ../../../../datasheet/SA868 2W Embedded walkie talkie moduleV1.2.pdf
.. _Slide and Rotary Encoder Switches: https://github.com/Xinyuan-LilyGO/T-TWR/blob/master/datasheet/Slide%20and%20Rotary%20Encoder%20Switches.pdf
