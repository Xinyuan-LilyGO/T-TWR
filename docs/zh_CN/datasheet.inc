数据手册
=========

* `ESP32-S3-WROOM-1-N16R8`_ (Datasheet)
* `OLED Display Module`_ (Datasheet)
* `SA868`_ (Datasheet)
* `Slide and Rotary Encoder Switches`_ (Datasheet)

.. _ESP32-S3-WROOM-1-N16R8: https://www.espressif.com.cn/sites/default/files/documentation/esp32-s3-wroom-1_wroom-1u_datasheet_cn.pdf
.. _OLED Display Module: https://github.com/Xinyuan-LilyGO/T-TWR/blob/master/datasheet/SPEC%20X096-2864KSWPG17-C30%20VER%20A.pdf
.. _SA868: https://github.com/Xinyuan-LilyGO/T-TWR/blob/master/datasheet/SA868%202W%E5%B5%8C%E5%85%A5%E5%BC%8F%E5%B0%8F%E4%BD%93%E7%A7%AF%E5%AF%B9%E8%AE%B2%E6%9C%BA%E6%A8%A1%E5%9D%97V1.2.pdf
.. _Slide and Rotary Encoder Switches: https://github.com/Xinyuan-LilyGO/T-TWR/blob/master/datasheet/Slide%20and%20Rotary%20Encoder%20Switches.pdf
